## conf/bblayers.conf.sample
```bitbake
#
# LAYER_CONF_VERSION is increased each time build/conf/bblayers.conf
# changes incompatibly
LCONF_VERSION = "6"

BBPATH = "${TOPDIR}"
BBFILES ?= ""
RDKROOT := "${@os.path.abspath(os.path.dirname(d.getVar('FILE', True)) + '/../..')}"

BBLAYERS ?= " \
  ${RDKROOT}/meta-rdk \
  ${@'${RDKROOT}/meta-qt5' if os.path.isfile('${RDKROOT}/meta-qt5/conf/layer.conf') else ''} \
  ${@'${RDKROOT}/meta-browser' if os.path.isfile('${RDKROOT}/meta-browser/conf/layer.conf') else ''} \
  ${@'${RDKROOT}/meta-java' if os.path.isfile('${RDKROOT}/meta-java/conf/layer.conf') else ''} \
  ${RDKROOT}/meta-openembedded/meta-webserver \
  ${RDKROOT}/meta-openembedded/meta-multimedia \
  ${RDKROOT}/meta-openembedded/meta-filesystems \
  ${RDKROOT}/meta-openembedded/meta-oe \
  ${RDKROOT}/meta-openembedded/meta-networking \
  ${@'' if os.path.isfile('${RDKROOT}/openembedded-core/meta/recipes-devtools/ruby/ruby.inc') else '${RDKROOT}/meta-openembedded/meta-ruby'} \
  ${@'${RDKROOT}/meta-linaro/meta-linaro' if os.path.isfile('${RDKROOT}/meta-linaro/meta-linaro/conf/layer.conf') else ''} \
  ${@'${RDKROOT}/meta-linaro/meta-linaro-toolchain' if os.path.isfile('${RDKROOT}/meta-linaro/meta-linaro-toolchain/conf/layer.conf') else ''} \
  ${RDKROOT}/openembedded-core/meta \
  ${@'${RDKROOT}/meta-rust' if os.path.isfile('${RDKROOT}/meta-rust/conf/layer.conf') else ''} \
  ${@'${RDKROOT}/meta-clang' if os.path.isfile('${RDKROOT}/meta-clang/conf/layer.conf') else ''} \
  ${@'${RDKROOT}/meta-gplv2' if os.path.isfile('${RDKROOT}/meta-gplv2/conf/layer.conf') else ''} \
  ${@'${RDKROOT}/meta-python2' if os.path.isfile('${RDKROOT}/meta-python2/conf/layer.conf') else ''} \
  "

# CPC requires dedicated licenses, we need to support build when CPC is not
# available. So we only add meta-rdk-comcast layer if it exists locally.
BBLAYERS =+ "${@'${RDKROOT}/meta-rdk-comcast' if os.path.isfile('${RDKROOT}/meta-rdk-comcast/conf/layer.conf') else ''}"
BBLAYERS += "${@'${RDKROOT}/meta-virtualization' if os.path.isfile('${RDKROOT}/meta-virtualization/conf/layer.conf') else ''}"
BBLAYERS += "${@'${RDKROOT}/meta-rdk-restricted' if os.path.isfile('${RDKROOT}/meta-rdk-restricted/conf/layer.conf') else ''}"
BBLAYERS += "${@'${RDKROOT}/meta-rdk-mesh' if os.path.isfile('${RDKROOT}/meta-rdk-mesh/conf/layer.conf') else ''}"
BBLAYERS =+ "${@'${RDKROOT}/meta-rdk-comcast-broadband' if os.path.isfile('${RDKROOT}/meta-rdk-comcast-broadband/conf/layer.conf') else ''}"
BBLAYERS += "${@'${RDKROOT}/meta-rdk-broadband' if os.path.isfile('${RDKROOT}/meta-rdk-broadband/conf/layer.conf') else ''}"
BBLAYERS =+ "${@'${RDKROOT}/meta-rdk-comcast-video' if os.path.isfile('${RDKROOT}/meta-rdk-comcast-video/conf/layer.conf') else ''}"
BBLAYERS += "${@'${RDKROOT}/meta-rdk-video' if os.path.isfile('${RDKROOT}/meta-rdk-video/conf/layer.conf') else ''}"
BBLAYERS += "${@'${RDKROOT}/meta-rdk-voice' if os.path.isfile('${RDKROOT}/meta-rdk-voice/conf/layer.conf') else ''}"
BBLAYERS += "${@'${RDKROOT}/meta-rdk-ext' if os.path.isfile('${RDKROOT}/meta-rdk-ext/conf/layer.conf') else ''}"
BBLAYERS += "${@'${RDKROOT}/meta-openembedded/meta-python' if os.path.isfile('${RDKROOT}/meta-openembedded/meta-python/conf/layer.conf') else ''}"
BBLAYERS =+ "${@'${RDKROOT}/meta-rdk-broadband-cmf-restricted' if os.path.isfile('${RDKROOT}/meta-rdk-broadband-cmf-restricted/conf/layer.conf') else ''}"
BBLAYERS =+ "${@'${RDKROOT}/meta-rtlwifi' if os.path.isfile('${RDKROOT}/meta-rtlwifi/conf/layer.conf') else ''}"
BBLAYERS =+ "${@'${RDKROOT}/meta-rdk-netflix' if os.path.isfile('${RDKROOT}/meta-rdk-netflix/conf/layer.conf') else ''}"
BBLAYERS =+ "${@'${RDKROOT}/meta-rdk-amazon' if os.path.isfile('${RDKROOT}/meta-rdk-amazon/conf/layer.conf') else ''}"
BBLAYERS += "${@'${RDKROOT}/meta-rdk-cujo' if os.path.isfile('${RDKROOT}/meta-rdk-cujo/conf/layer.conf') else ''}"
BBLAYERS += "${@'${RDKROOT}/meta-rdk-broadband-cmf-poc' if os.path.isfile('${RDKROOT}/meta-rdk-broadband-cmf-poc/conf/layer.conf') else ''}"
BBLAYERS += "${@'${RDKROOT}/meta-rdk-cognitive/meta-rdk-cognitive' if os.path.isfile('${RDKROOT}/meta-rdk-cognitive/meta-rdk-cognitive/conf/layer.conf') else ''}"
```

## conf/distro/include/gstreamer-versions.inc
```bitbake
# enable gstreamer1
DISTRO_FEATURES:append = " gstreamer1"

# toggle gstreamer 1.4 and 1.10

# Comment out Old version & use the latest version
#GST_VERSION = "1.4.4"
#ORC_VERSION = "0.4.18"

#GST_VERSION ?= "1.10.4"
#ORC_VERSION = "0.4.26"

GST_VERSION ?= " ${@bb.utils.contains('DISTRO_FEATURES', 'gstreamer1_18', '1.18.5', '1.10.4', d)}"
ORC_VERSION = " ${@bb.utils.contains('DISTRO_FEATURES', 'gstreamer1_18', '0.4.31', '0.4.26', d)}"

PREFERRED_VERSION_gstreamer1.0 ??= "${GST_VERSION}"
PREFERRED_VERSION_gstreamer1.0-libav ??= "${GST_VERSION}"
PREFERRED_VERSION_gstreamer1.0-plugins-bad ??= "${GST_VERSION}"
PREFERRED_VERSION_gstreamer1.0-plugins-base ??= "${GST_VERSION}"
PREFERRED_VERSION_gstreamer1.0-plugins-good ??= "${GST_VERSION}"
PREFERRED_VERSION_gstreamer1.0-omx ??= "${GST_VERSION}"
PREFERRED_VERSION_nativesdk-orc ??= "${ORC_VERSION}"
```

## conf/distro/include/license_flags_accepted.inc
```bitbake
#This file will be included for yocto versions dunfell and higher.
LICENSE_FLAGS_ACCEPTED += "commercial_gst-fluendo-mpegdemux \
                            commercial_${MLPREFIX}gst-ffmpeg \
                            ${@bb.utils.contains('DISTRO_FEATURES', 'gstreamer1_18','commercial_${MLPREFIX}ffmpeg','commercial_${MLPREFIX}libav',d)} \
                            commercial_libomxil \
                            commercial_gst-openmax \
                            commercial_mpg123 \
                            commercial_x264 \
                            commercial_gstreamer1.0-omx \
                            commercial_${MLPREFIX}gstreamer1.0-libav"
```

## conf/distro/include/license_flags_whitelist.inc
```bitbake
#This file will be included for yocto versions morty and daisy.
LICENSE_FLAGS_ACCEPTED += "commercial_gst-fluendo-mpegdemux \
                            commercial_${MLPREFIX}gst-ffmpeg \
                            ${@bb.utils.contains('DISTRO_FEATURES', 'gstreamer1_18','commercial_${MLPREFIX}ffmpeg','commercial_${MLPREFIX}libav',d)} \
                            commercial_libomxil \
                            commercial_gst-openmax \
                            commercial_mpg123 \
                            commercial_${MLPREFIX}x264 \
                            commercial_gstreamer1.0-omx \
                            commercial_${MLPREFIX}gstreamer1.0-libav"
```

## conf/distro/include/qt5-versions.inc
```bitbake
QTVER = "${@bb.utils.contains('DISTRO_FEATURES','comcast_qt5', '5.1.1%', '5.15.7', d)}"

PREFERRED_VERSION_qtbase-native = "${QTVER}"
PREFERRED_VERSION_qtbase = "${QTVER}"
PREFERRED_VERSION_qtdeclarative = "${QTVER}"
PREFERRED_VERSION_qtgraphicaleffects = "${QTVER}"
PREFERRED_VERSION_qtimageformats = "${QTVER}"
PREFERRED_VERSION_qtjsbackend-native = "${QTVER}"
PREFERRED_VERSION_qtjsbackend = "${QTVER}"
PREFERRED_VERSION_qtmultimedia = "${QTVER}"
PREFERRED_VERSION_qtquick1 = "${QTVER}"
PREFERRED_VERSION_qtscript = "${QTVER}"
PREFERRED_VERSION_qtsensors = "${QTVER}"
PREFERRED_VERSION_qtsvg = "${QTVER}"
PREFERRED_VERSION_qtwebkit-examples = "${QTVER}"
PREFERRED_VERSION_qtwebkit = "${QTVER}"
PREFERRED_VERSION_qtxmlpatterns = "${QTVER}"
PREFERRED_VERSION_qtlocation = "4.999+5.0.0%"
##
PREFERRED_VERSION_qtconnectivity = "${QTVER}"
PREFERRED_VERSION_qtquickcontrols = "${QTVER}"
PREFERRED_VERSION_qttools = "${QTVER}"
PREFERRED_VERSION_nativesdk-qtbase = "${QTVER}"
PREFERRED_VERSION_nativesdk-qttools = "${QTVER}"
PREFERRED_VERSION_qtserialport = "${QTVER}"
```

## conf/distro/include/rdk-esdk-conf.inc
```bitbake
# eSDK distro Changes
INHERIT:append = " uninative image-buildinfo"
include  conf/distro/include/yocto-uninative.inc
SDK_INCLUDE_NATIVESDK = "1"
require ${@bb.utils.contains('DISTRO_FEATURES','kirkstone','setscene_enforce_ignore_tasks.inc','setscene_enforce_whitelist.inc',d)}
IMGCLASSES += "populate_sdk_ext"
SDK_EXT_TYPE ?= "full"
```

## conf/distro/include/rdk-versions.inc
```bitbake
#
# root location of Generic RDK components
RDK_GENERIC_ROOT_SVN ?= "svn5.teamccp.com/svn/rdk/components/generic"
RDK_GIT ?= "gerrit.teamccp.com:29418"
CMF_GIT_ROOT ?= "git://code.rdkcentral.com/r"
RBUS_RDKCENTRAL_GIT ?= "https://github.com/rdkcentral/rbus.git"
RDK_GIT_PROTOCOL ?= "ssh"
RDK_RELEASE ?= "1.99"
RDK_GENERIC_ROOT_GIT ?= "git://${RDK_GIT}/rdk/components/generic"
RDK_COMPONENTS_ROOT_GIT ?= "git://${RDK_GIT}/rdk/components"
RDKB_COMPONENTS_ROOT_GIT ?= "git://${RDK_GIT}/rdk/rdkb/components"
RDKB_CCSP_ROOT_GIT ?= "git://${RDK_GIT}/rdk/rdkb/components/opensource/ccsp"
RDKB_COMPONENTS_OS_GIT ?= "git://${RDK_GIT}/rdk/components/opensource"
RDK_GIT_BRANCH ?= "stable2"
CCSP_GIT_BRANCH ?= "stable2"
PROJECT_BRANCH ?= "default"

CMF_GIT_ROOT ?= "git://code.rdkcentral.com/r"
CMF_GIT_PROTOCOL ?= "https"
CMF_RDK_COMPONENTS_ROOT_GIT ?= "${CMF_GIT_ROOT}/rdk/components"
CMF_RDKB_COMPONENTS_ROOT_GIT ?= "${CMF_GIT_ROOT}/rdkb/components"
CMF_RDKB_CCSP_ROOT_GIT ?= "${CMF_RDKB_COMPONENTS_ROOT_GIT}/opensource/ccsp"
CMF_GIT_BRANCH ?= "rdk-next"
CMF_GIT_MASTER_BRANCH ?= "master"

CMF_GITHUB_ROOT ?= "git://github.com/rdkcentral"
CMF_GITHUB_PROTOCOL = "https"
CMF_GITHUB_BRANCH = "nobranch=1"
CMF_GITHUB_SRC_URI_SUFFIX = "protocol=${CMF_GITHUB_PROTOCOL};${CMF_GITHUB_BRANCH}"
CMF_GITHUB_MAIN_BRANCH ?= "main"
CMF_GITHUB_MASTER_BRANCH ?= "master"
CMF_GITHUB_STABLE2_BRANCH ?= "stable2"
```

## conf/distro/include/rdk_security_flags.inc
```bitbake
# ASLR enabled
# we set this to "y" or "n" and use it as a conditional later

ASLR = "${@bb.utils.contains('DISTRO_FEATURES', 'aslr', 'y', 'n', d)}"

# toggle aslr off for specific packages
ASLR:pn-ccsp-wifi-agent = "n"
ASLR:pn-docsis = "n"
# ASLR:pn-hal-wifi = "n"
ASLR:pn-mesh-agent = "n"
ASLR:pn-tr69hostif = "n"
ASLR:pn-qtbase = "n"
ASLR:pn-ccsp-xconf = "n"
ASLR:pn-qtn-csmd-logic = "n"
ASLR:pn-plumewifi = "n"
ASLR:pn-hal-mta-broadcom = "n"
ASLR:pn-broadcom-refsw = "n"
ASLR:pn-broadcom-ursr = "n"
ASLR:pn-ccsp-xdns = "n"

# Warn on use of format strings that represent possible security problems
SECURITY_STRINGFORMAT ?= "-Wformat -Wformat-security -Wno-error=format-security"

# packages which explicitly set a "-Wno-format" preventing the -Wformat-security checks
# (we remove -Wformat-security or the compiler crashes on the conflict with -Wno-format)

SECURITY_STRINGFORMAT:pn-audiohal = ""
SECURITY_STRINGFORMAT:pn-gptimer = ""
SECURITY_STRINGFORMAT:pn-pcd = ""
SECURITY_STRINGFORMAT:pn-qtn-qwcfg = ""

# ASLR support
# --enable-default-pie   compile as position independent executable (gcc-6.x)
# -no-pie                cancel the effects of --enable-default-pie (gcc-6.x)
#
# Additional compile flags
# _FORTIFY_SOURCE        perform additional compile time checks
# -fstack-protector      protect stack against buffer overruns
# -Wl,-z,relro,-z,now    prevent changes to relocation entries

SECURITY_NOPIE ?= "${@ASLR == "y" and GCCVERSION > "6.0" and "-no-pie -fno-PIE" or ""}"
SECURITY_FORTIFY ?= "-D_FORTIFY_SOURCE=2 -Wno-error=unused-result"
SECURITY_CFLAGS ?= "-fstack-protector ${SECURITY_FORTIFY} ${SECURITY_STRINGFORMAT}"
SECURITY_NO_PIE_CFLAGS ?= "-fstack-protector ${SECURITY_FORTIFY} ${SECURITY_STRINGFORMAT} ${SECURITY_NOPIE}"
SECURITY_LDFLAGS ?= "-fstack-protector -Wl,-z,relro"
# removed this from SECURITY_LDFLAGS ",-z,now"

# packages which break due to the extra compiler checks enabled by _FORTIFY
# most of these are caused by calls to open() with O_CREAT that are mising file permissions
# (TODO: patch compile issues and remove these lines)

SECURITY_FORTIFY:pn-alljoyn = ""
SECURITY_FORTIFY:pn-audiohal = ""
SECURITY_FORTIFY:pn-avcap-samples = ""
SECURITY_FORTIFY:pn-bluetooth-core = ""
SECURITY_FORTIFY:pn-ccsp-tr069-pa = ""
SECURITY_FORTIFY:pn-ccsp-p-and-m = ""
SECURITY_FORTIFY:pn-ccsp-snmp-pa = ""
SECURITY_FORTIFY:pn-comcast-firmwaretool = ""
SECURITY_FORTIFY:pn-ctrlm-testapp = ""
SECURITY_FORTIFY:pn-dial = ""
SECURITY_FORTIFY:pn-docsis = ""
SECURITY_FORTIFY:pn-ebtables = ""
SECURITY_FORTIFY:pn-ecfs-search = ""
SECURITY_FORTIFY:pn-extswitch = ""
SECURITY_FORTIFY:pn-factory-nvram = ""
SECURITY_FORTIFY:pn-gdb = ""
SECURITY_FORTIFY:pn-hal-cm-xb6 = ""
SECURITY_FORTIFY:pn-keyutils = ""
SECURITY_FORTIFY:pn-liblan-service = ""
SECURITY_FORTIFY:pn-libpcd = ""
SECURITY_FORTIFY:pn-libunwind = ""
SECURITY_FORTIFY:pn-logger = ""
SECURITY_FORTIFY:pn-mini-cli = ""
SECURITY_FORTIFY:pn-ncurses = ""
SECURITY_FORTIFY:pn-otamgr = ""
SECURITY_FORTIFY:pn-pcd = ""
SECURITY_FORTIFY:pn-production-data = ""
SECURITY_FORTIFY:pn-qca = ""
SECURITY_FORTIFY:pn-qtn-qwcfg = ""
SECURITY_FORTIFY:pn-qtn-qevent = ""
SECURITY_FORTIFY:pn-ucresolv = ""
SECURITY_FORTIFY:pn-upgradebox = ""
SECURITY_FORTIFY:pn-utopia = ""
SECURITY_FORTIFY:pn-xrtestapp = ""
SECURITY_FORTIFY:pn-broadcom-mocadriver = ""


# workarounds for various packages
SECURITY_CFLAGS:append:pn-broadcom-refsw = " ${SECURITY_NOPIE} ${SECURITY_LDFLAGS}"
SECURITY_CFLAGS:append:pn-broadcom-ursr = " ${SECURITY_NOPIE} ${SECURITY_LDFLAGS}"
SECURITY_CFLAGS:append:pn-ctrlm-main = " ${SECURITY_NOPIE} ${SECURITY_LDFLAGS}"

# don't set eglibc compile flags
SECURITY_CFLAGS:pn-eglibc = ""
SECURITY_CFLAGS:pn-eglibc-initial = ""
SECURITY_LDFLAGS:remove:pn-eglibc = "-fstack-protector"
SECURITY_LDFLAGS:remove:pn-eglibc-initial = "-fstack-protector"

# don't set glibc compile flags
SECURITY_CFLAGS:pn-glibc = ""
SECURITY_CFLAGS:pn-glibc-initial = ""
SECURITY_LDFLAGS:remove:pn-glibc = "-fstack-protector"
SECURITY_LDFLAGS:remove:pn-glibc-initial = "-fstack-protector"

SECURITY_CFLAGS:pn-gcc-runtime = ""
SECURITY_LDFLAGS:remove:pn-gcc-runtime = "-fstack-protector"

# kernel modules can't be -pie
TARGET_CC_KERNEL_ARCH:append = " ${SECURITY_NOPIE}"
MAKE:append:pn-broadcom-refsw = " KCFLAGS=-fno-PIE"
MAKE:append:pn-broadcom-ursr = " KCFLAGS=-fno-PIE"
MOD_OPTS:append:pn-broadcom-rgdriver = " KCFLAGS=-fno-PIE"

TARGET_CC_ARCH:append:class-target = " ${@ASLR == "y" and SECURITY_CFLAGS or ""}"
TARGET_LDFLAGS:append:class-target = " ${@ASLR == "y" and SECURITY_LDFLAGS or ""}"

include conf/distro/include/rdk_security_flags-cpc.inc
```
