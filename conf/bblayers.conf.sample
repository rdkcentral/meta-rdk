## conf/layer.conf
```bitbake
BBPATH .= ":${LAYERDIR}"

BBFILES += "\
            ${LAYERDIR}/recipes-*/*/*.bb \
            ${LAYERDIR}/recipes-*/*/*.bbappend \
           "

BBFILE_COLLECTIONS += "rdk"
BBFILE_PATTERN_rdk := "^${LAYERDIR}/"
BBFILE_PRIORITY_rdk = "7"

LAYERSERIES_COMPAT_rdk = "zeus dunfell kirkstone"

# Additional license directories.
LICENSE_PATH += "${LAYERDIR}/licenses"

LAYERDEPENDS_rdk = "multimedia-layer"

# This get prepended at last but its not a template
# but a must. For your own additions to BBMASK
# add BBMASK .= "!<pattern>"
# in your layer
BBMASK =. "recipes-gnome/gnome-settings-daemon"
BBMASK .= "|.meta-rdk-oss-reference/recipes-rdk/breakpad_wrapper/breakpad-wrapper.bb"
require ${@bb.utils.contains_any('DISTRO_FEATURES','morty daisy','include/hashbase_whitelist.inc','include/basehash_ignore_vars.inc',d)}

DISTRO_FEATURES:append = " ptest "
EXTRA_IMAGE_FEATURES += "ptest-pkgs"
PTESTS_REMOVE:pn-core-image-ptest:append  = " diffutils "
PTEST_ENABLED:pn-bluez5 = "0"
IMAGE_INSTALL:remove = "diffutils-ptest gawk-ptest gdbm-ptest gettext-ptest gzip-ptest m4-ptest openssl-ptest parted-ptest sed-ptest bluez5-ptest busybox-ptest coreutils-ptest findutils-ptest elfutils-ptest  quilt-ptest e2fsprogs-ptest lttng-tools-ptest strace-ptest apr-util-ptest apr-ptest valgrind-ptest  pango-ptest "
LICENSE_FLAGS_ACCEPTED += "GPL-3.0-only"
LICENSE_FLAGS_ACCEPTED += "GPL-3.0-or-later"
PREFERRED_VERSION_libarchive = "3.6.2"
PREFERRED_VERSION_gmp = "6.2.1"
#TEST_IMAGE_AUTO = "1"
##TEST_SUITES = "ssh ptest"
##TOOLCHAIN_HOST_TASK:append = " iproute2-native"
#
## Allow missing host ip tool
##HOSTTOOLS_NONFATAL += "ip"
##
## # Build native ip tool required by testimage
##IMAGE_CLASSES += "testimage"
INCOMPATIBLE_LICENSE:remove = " GPL-3.0-only LGPL-3.0-only LGPL-3.0-or-later  GPL-3.0-or-later"
RDEPENDS:remove:pn-core-image-ptest = "diffutils-ptest"
INSANE_SKIP:pn-zlib = "ldflags"
CFLAGS:append:pn-glibc-tests = " -Wno-error=format-overflow"
```
