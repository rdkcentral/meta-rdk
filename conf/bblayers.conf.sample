## conf/distro/rdk.conf
```bitbake
#
# Distribution definition for: rdk
#

DISTRO = "rdk"
DISTRO_NAME = "RDK (A Yocto Project based Distro)"
DISTRO_VERSION = "2.0"
DISTRO_CODENAME ?= "daisy"
SDK_VENDOR = "-rdksdk"
SDK_VERSION := "${@'${DISTRO_VERSION}'.replace('snapshot-${DATE}','snapshot')}"
SDK_NAME = "${DISTRO}-${TCLIBC}-${SDK_ARCH}-${TARGET_ARCH}"
SDKPATH = "/opt/${DISTRO}/${SDK_VERSION}"
IMGDEPLOYDIR_daisy = "${DEPLOY_DIR_IMAGE}"

# Add DISTRO_CODENAME to the list of OVERRIDES that bitbake checks when parsing
# overrides in recipes, similar to hybrid, mediaclient, broadband.
OVERRIDES .= ":${DISTRO_CODENAME}"

MAINTAINER ?= "CPE SI Yocto Team <CCP_CPESI-YOCTO@cable.comcast.com>"

TARGET_VENDOR = "-rdk"

LOCALCONF_VERSION = "1"
LAYER_CONF_VERSION ?= "6"

# We dont want (L)GPL-3.0+
INCOMPATIBLE_LICENSE = "${@bb.utils.contains_any("DISTRO_FEATURES", "kirkstone", "LGPL-3.0-or-later LGPL-3.0-only GPL-3.0-or-later GPL-3.0-only", "GPLv3.0 GPLv3 GPL-3.0 GPLv3+ LGPLv3.0 LGPLv3 LGPL-3.0 LGPLv3+", d)}"

COVERITY_REQUIRED ?= "0"
COVERITY_DIR ?= "coverity_dir"

# Enable thumb2 by default
ARM_INSTRUCTION_SET_morty:armv7a = "thumb"
ARM_INSTRUCTION_SET_morty:armv7ve = "thumb"

IGNORE_INIT_MNGR ?= "sysvinit"

DISTRO_FEATURES_BACKFILL_CONSIDERED += "${IGNORE_INIT_MNGR}"

TCLIBCAPPEND = ""

QEMU_TARGETS_daisy = "arm i386 mips mipsel ppc x86_64"


# RDK builds can sometimes trigger the "version-going-backwards" sanity check.
# Since the check is most relevant for creating package feeds, which are not
# used by the RDK, prevent it from ever being treated as a fatal error.
ERROR_QA:remove = "version-going-backwards"

# Historically (ie in OE 1.6 builds) BB_DANGLINGAPPENDS_WARNONLY has been set
# indirectly via meta-linaro and meta-linaro-toolchain layer.conf files. Since
# RDK builds rely on it heavily (there are typically many dangling .bbappends)
# define explicitly to avoid hidden dependencies on the Linaro meta layers.
BB_DANGLINGAPPENDS_WARNONLY = "true"

#-----------------------------------------------------------------------------
# Default RDK distro features (which may then be modified by rdkv.inc, etc).
#-----------------------------------------------------------------------------

DISTRO_FEATURES_BACKFILL_CONSIDERED = "pulseaudio"
DISTRO_FEATURES_BACKFILL_CONSIDERED += "gobject-introspection-data"
DISTRO_FEATURES_BACKFILL_CONSIDERED += "sysvinit"
DISTRO_FEATURES_BACKFILL_CONSIDERED += "ldconfig"

DISTRO_FEATURES_RDK ?= "rdk-dlna"

DISTRO_FEATURES = "alsa argp logbacktrace directfb ext2 ipv4 ipv6 largefile multiarch nfs opengl pam systemd usbhost wayland xattr zeroconf directfb wayland pam opencdm ${DISTRO_FEATURES_RDK}"

DISTRO_FEATURES:remove_rpi = "directfb"

EXTRA_BLUETOOTH_STUFF := "${@bb.utils.contains('DISTRO_FEATURES', 'bluetooth', bb.utils.contains('DISTRO_FEATURES', 'bluez5', ' bluez5', ' bluez4', d), '', d)}"
DISTRO_FEATURES:append = "${EXTRA_BLUETOOTH_STUFF}"

VIRTUAL-RUNTIME_init_manager ?= "systemd"
VIRTUAL-RUNTIME_initscripts ?= "systemd-compat-units"

IMAGE_FSTYPES += "tar.gz"

# The mtrace script included by eglibc is a perl script. This means the system
# will build perl in case this package is installed. Since we don't care about
# this script for the purposes of tiny, remove the dependency from here.
RDEPENDS:${PN}-mtrace:pn-eglibc = ""

require ${@bb.utils.contains_any('DISTRO_FEATURES','dunfell morty daisy','include/license_flags_whitelist.inc','include/license_flags_accepted.inc',d)}

# Mask the meta-linaro recipes for qemu and gdb to force use of the versions from oe-core
BBMASK .= "|meta-linaro/meta-linaro/recipes-devtools/qemu"
BBMASK .= "|meta-linaro/meta-linaro-toolchain/recipes-devtools/gdb"

# Mask apparmor bb file for morty supported devices
BBMASK .= "${@bb.utils.contains_any('DISTRO_FEATURES', 'dunfell kirkstone', '', '|meta-rdk-ext/recipes-mac/AppArmor/apparmor_2.13.4.bb', d)}"

# Mask recipes which are not used in morty build to avoid parse error
BBMASK .= "${@bb.utils.contains('DISTRO_FEATURES', 'morty', '|meta-rdk-broadband/recipes-support/dnsmasq/dnsmasq_2.83.bb', '', d)}"
BBMASK .= "${@bb.utils.contains('DISTRO_FEATURES', 'morty', '|meta-rdk-ext/recipes-kernel/linux-libc-headers/linux-libc-headers_5.4.bb', '', d)}"

# Mask recipes which are not used in build to avoid parse error with kirkstone
BBMASK .= "${@bb.utils.contains('DISTRO_FEATURES', 'kirkstone', "|meta-rdk-ext/recipes-common/lighttpd-1.4.39/lighttpd_1.4.39.bb", "", d)}"

# Mask new bb files added as part of RDK-35552 and enable based on distro flag enable_libsoup3. This is to avoid parse error for morty and daisy builds where these latest bb files are not compatible. 
BBMASK .= "${@bb.utils.contains('DISTRO_FEATURES', 'enable_libsoup3', "", "|.meta-rdk-ext/recipes-support/libsoup/libsoup_3.0.7.bb|.meta-rdk-ext/recipes-support/libsoup/libsoup_3.4.2.bb|.meta-rdk-ext/recipes-support/nghttp2/nghttp2_1.48.0.bb|.meta-rdk-ext/recipes-support/libpsl/libpsl_0.21.1.bb|.meta-rdk-ext/recipes-devtools/meson/meson_0.55.1.bb|.meta-rdk-ext/recipes-devtools/meson/nativesdk-meson_0.55.1.bb|.meta-rdk-ext/recipes-core/glib-2.0/glib-2.0_2.72.3.bb|.meta-rdk-ext/recipes-core/glib-networking/glib-networking_2.72.2.bb", d)}"

# Mask new bb files added as part of RDK-38631 and enable based on distro flag netflix_6_1. This is to avoid parse error for other platforms
BBMASK .= "${@bb.utils.contains('DISTRO_FEATURES', 'netflix_6_1', "", "|.meta-rdk-ext/recipes-devtools/cmake/cmake-native_3.19.2.bb|.meta-rdk-ext/recipes-devtools/cmake/cmake_3.19.2.bb", d)}"

# Mask breakpad svn file for dunfell builds, use latest breakpad source from git bb file - RDKTV-22927
BBMASK .= "${@bb.utils.contains('DISTRO_FEATURES', 'dunfell', "|.meta-openembedded/meta-oe/recipes-devtools/breakpad/breakpad_svn.bb", "", d)}"

PREFERRED_PROVIDER_qemu-native = "qemu-native"

PREFERRED_VERSION_gupnp = "0.20.10%"
PREFERRED_VERSION_gupnp_dunfell = "0.20.10%"
PREFERRED_VERSION_gupnp-av:kirkstone = "0.14.0%"

PREFERRED_VERSION_elfutils ?= "${@bb.utils.contains('DISTRO_FEATURES', 'benchmark_enable', '0.148', '', d)}"
PREFERRED_VERSION_glib-networking:kirkstone = "2.72.2"
PREFERRED_VERSION_gssdp:kirkstone = "1.4.0.1"

# Set GPTFDISK version for Morty and Dunfell devices
PREFERRED_VERSION_gptfdisk_morty ?= "1.0.1"
PREFERRED_VERSION_gptfdisk_dunfell ?= "1.0.4"

# Legacy workaround for OE 1.6 (set by default from oe-core in OE 1.7 and later)
# http://git.openembedded.org/openembedded-core/commit/?id=be1e7909abb1fc27087b2b99b183da260f9653af
PREFERRED_VERSION_binutils-native ?= "${BINUVERSION}"

PREFERRED_VERSION_libnl ?= "3.3.0"
PREFERRED_VERSION_libnl_dunfell ?= "3.5.0"

PREFERRED_PROVIDER_media-ctl = "media-ctl"
PREFERRED_PROVIDER_virtual/gst-plugins-playersinkbin ?= "gst-plugins-playersinkbin-noop"
PREFERRED_PROVIDER_virtual/iarmmgrs-hal ?= "iarmmgrs-hal-noop"
PREFERRED_PROVIDER_virtual/sectionfilter-hal ?= "sectionfilter-hal-noop"
PREFERRED_PROVIDER_virtual/samplemedia ?= "comcast-samplemedia"
PREFERRED_PROVIDER_directfb ?= "directfb"
PREFERRED_PROVIDER_virtual/mfrlib ?= "mfrlib-noop"
PREFERRED_PROVIDER_virtual/ea-games-provider ?= "ea-games-provider-dummy"

# RDK component versions
require include/rdk-versions.inc

# RDK still uses QT 5.1
require include/qt5-versions.inc

# autoload if installed
module_autoload_snd-intel8x0 = "snd-intel8x0"

#added preferred version for wpa_supplicant
PREFERRED_VERSION_wpa-supplicant = "2.10"

PREFERRED_VERSION_libsoup-2.4 ?= "2.58%"
PREFERRED_VERSION_libsoup-2.4_dunfell = "2.68%"
PREFERRED_VERSION_libsoup-2.4:kirkstone = "2.74%"

# Added the preferred version for harfbuzz to support project RED font test cases.
PREFERRED_VERSION_libharfbuzz = "1.0.1"

# we have a choice to pick between external libc or eglibc
PREFERRED_PROVIDER_eglibc = "eglibc"

# jpeg or jpeg-turbo
PREFERRED_PROVIDER_jpeg = "libjpeg"
PREFERRED_PROVIDER_jpeg-native = "libjpeg"

# use prebuilt binary by default
PREFERRED_PROVIDER_playreadycdmi ?= "playreadycdmi"

# use prebuilt binary by default for wpe-webkit
# PREFERRED_PROVIDER_wpe-webkit ?= "wpe-webkit-pbt"
# WPEWEBKITSRCMASK ?= "|.wpe-webkit_.*"
# BBMASK .= "${WPEWEBKITSRCMASK}"

# build from source by default for project red
PREFERRED_PROVIDER_netflix ?= "netflix"

# build from source by default for playready
PREFERRED_PROVIDER_playready ?= "playready-cdm-rdk"

# build from source by default for netflix plugin executable
PREFERRED_PROVIDER_nrdplugin ?= "nrdplugin"

# use prebuilt binary by default for code big utils
PREFERRED_PROVIDER_cb-utils ?= "cb-utils-pbt"

# use prebuilt binary by default for key-obfuscator
PREFERRED_PROVIDER_key-obfuscator ?= "key-obfuscator-pbt"

# use prebuilt binary by default for icontrolkey
PREFERRED_PROVIDER_icontrolkey ?= "icontrolkey-pbt"
ICONTROLKEYSRCMASK ?= "|.icontrolkey-bld"
BBMASK .= "${ICONTROLKEYSRCMASK}"

require include/gstreamer-versions.inc

# Dont put ldconfig on target
USE_LDCONFIG = "0"

IMAGE_LINGUAS = ""
ENABLE_BINARY_LOCALE_GENERATION = "0"

# ----------------------------------------------------------------------------

OPTIMIZE_DEFAULT ?= "-O2"

FULL_OPTIMIZATION = "${OPTIMIZE_DEFAULT} -pipe ${DEBUG_FLAGS}"

# ----------------------------------------------------------------------------

# If the "backtrace" Distro feature is enabled (which it is by default), then
# prevent the compiler from optimising away the frame pointer or making sibling
# and tail recursive calls, which in turn enables breakpad and other debug
# tools to generate more reliable backtraces. If breakpad is not required then
# the backtrace distro feature may be disabled to gain a small improvement in
# code size and performance.

TUNE_CCARGS:append = "${@bb.utils.contains('DISTRO_FEATURES', 'backtrace', ' -fno-omit-frame-pointer -fno-optimize-sibling-calls', '',d)}"

# we dont want static hwdb
BAD_RECOMMENDATIONS = "\
  udev-hwdb \
  qtbase-fonts-ttf-vera \
  qtbase-fonts-pfa \
  qtbase-fonts-qpf \
"

#PRSERV_HOST = "localhost:0"

SPLASH ?= "plymouth"

PREFERRED_PROVIDER_virtual/java-initial ?= "cacao-initial-native"
PREFERRED_PROVIDER_virtual/java-initial-native ?= "cacao-initial-native"
PREFERRED_PROVIDER_virtual/java-native ?= "jamvm-native"
PREFERRED_PROVIDER_virtual/javac-native ?= "ecj-bootstrap-native"
PREFERRED_PROVIDER_virtual/jvm ?= "jvm-noop"

STAGING_KERNEL_BUILDDIR ?= "${STAGING_KERNEL_DIR}"

VOLATILE_BINDS = "/var/volatile/www /www\n"
VOLATILE_BINDS:append = "/var/volatile/resolv.conf /etc/resolv.conf\n"
VOLATILE_BINDS:append = "/var/volatile/asound.conf /etc/asound.conf\n"
VOLATILE_BINDS:append = "/var/volatile/resolv.dnsmasq /etc/resolv.dnsmasq\n"
VOLATILE_BINDS:append = "/var/volatile/hosts /etc/hosts\n"
VOLATILE_BINDS:append = "/var/volatile/hostname /etc/hostname\n"
VOLATILE_BINDS:append = "/var/volatile/dhcp_static_hosts /etc/dhcp_static_hosts\n"
VOLATILE_BINDS:append = "/var/volatile/cron /var/spool/cron\n"
VOLATILE_BINDS:append:hybrid = "/tmp/snmpd.conf /etc/snmp/snmpd.conf\n"
VOLATILE_BINDS:append:client = "/tmp/timesyncd.conf /etc/systemd/timesyncd.conf\n"
VOLATILE_BINDS:append:hybrid = "/tmp/udhcpc.vendor_specific /etc/udhcpc.vendor_specific\n"
VOLATILE_BINDS:append = "${@bb.utils.contains('DISTRO_FEATURES', 'ENABLE_NETWORKMANAGER', '', '/tmp/dibbler /etc/dibbler\n' , d)}"
VOLATILE_BINDS:append = " /var/volatile/xupnp /etc/xupnp\n "
VOLATILE_BINDS:append = "/tmp/named.conf.options /etc/bind/named.conf.options\n"
VOLATILE_BINDS:append = "/tmp/bind /var/cache/bind\n"
VOLATILE_BINDS:append = "/tmp/stunnel.conf /etc/stunnel.conf\n"
VOLATILE_BINDS:append:client = "/var/volatile/rdk_chrony.conf /etc/rdk_chrony.conf\n"


XZ_COMPRESSION_LEVEL ?= "-e -M 50% -9"

include include/rdk-external-src.inc

DISTRO_FEATURES:append = " netflix_wayland_client"
#DISTRO_FEATURES:append = " netflix_essos_client"

DISTRO_FEATURES:remove_morty = " zeroconf"
DISTRO_FEATURES:remove = " zeroconf backtrace"

PREFERRED_VERSION_iw = "4.7"
PREFERRED_VERSION_log4c = "1.2.3"

# Adding PREFERRED_VERSION for applications upgraded due to CVEs
# and recipes held back to older versions when newer versions have
# switched to (L)GPLv3

PREFERRED_VERSION_libtasn1 = "4.8"
PREFERRED_VERSION_gnutls ?= "3.5.%"
PREFERRED_VERSION_libpcre = "8.39"

PREFERRED_VERSION_dibbler_morty ?= "1.0.1"

PREFERRED_VERSION_cmake ?= "2.8.12.2"
PREFERRED_VERSION_bash ?= "3.2.%"
PREFERRED_VERSION_msgpack-c ?= "2.1.1%"

PREFERRED_VERSION_systemd_pyro = "1:232%"
PREFERRED_VERSION_systemd_rocko = "1:234%"
PREFERRED_VERSION_systemd_thud = "1:239%"
PREFERRED_VERSION_systemd:kirkstone:client ?= "1:230%"
PREFERRED_VERSION_xfsprogs ?= "3.1%"
#PREFERRED_VERSION_xfsprogs_morty ?= "3.1.11"
#PREFERRED_VERSION_xfsprogs_dunfell = "5.2.1"

# When building the legacy systemd 216 recipe from meta-rdk (where libgudev is
# part of systemd) with OE 2.1 (which contains an independent libgudev recipe)
# we need to ensure that the systemd 216 libgudev is used instead of the
# libgudev recipe from oe-core.
PREFERRED_PROVIDER_libgudev = "${@oe.utils.conditional('PREFERRED_VERSION_systemd', '1:216%', 'systemd', 'libgudev', d)}"

# Stick with the older nmap 6.47 recipe for OE 1.6 and OE 2.1 to avoid build issues.
# Let OE 2.2 and later builds default to using the latest available nmap.
PREFERRED_VERSION_nmap_daisy ?= "6.47"
PREFERRED_VERSION_nmap_krogoth ?= "6.47"

PREFERRED_VERSION_openssl_pyro = "1.0.2n"
PREFERRED_VERSION_openssl-native_pyro = "1.0.2n"
PREFERRED_VERSION_nativesdk-openssl_pyro = "1.0.2n"

PREFERRED_VERSION_openssl_rocko = "1.0.2n"
PREFERRED_VERSION_openssl-native_rocko = "1.0.2n"
PREFERRED_VERSION_nativesdk-openssl_rocko = "1.0.2n"

PREFERRED_VERSION_openssl_thud = "1.0.2o"
PREFERRED_VERSION_openssl-native_thud = "1.0.2o"
PREFERRED_VERSION_nativesdk-openssl_thud = "1.0.2o"

PREFERRED_VERSION_openssl_dunfell = "${@bb.utils.contains('DISTRO_FEATURES', 'yocto-3.1.15', '1.1.1n', '1.1.1l', d)}"
PREFERRED_VERSION_openssl-native_dunfell = "${@bb.utils.contains('DISTRO_FEATURES', 'yocto-3.1.15', '1.1.1n', '1.1.1l', d)}"
PREFERRED_VERSION_nativesdk-openssl_dunfell = "${@bb.utils.contains('DISTRO_FEATURES', 'yocto-3.1.15', '1.1.1n', '1.1.1l', d)}"

PREFERRED_VERSION_openssl:kirkstone = "3.0.%"
PREFERRED_VERSION_openssl-native:kirkstone = "3.0.%"
PREFERRED_VERSION_nativesdk-openssl:kirkstone = "3.0.%"

PREFERRED_VERSION_iperf3:kirkstone = "3.11"
PREFERRED_VERSION_librsvg:kirkstone = "2.40.21"

# gmp 4.2.1 is the last version released as LGPLv2
# nettle 2.7.1 is the last version released as LGPLv2
# gnutls 3.3.x is the last branch which supports nettle 2.7.1
PREFERRED_VERSION_gmp ?= "4.2.1"
PREFERRED_VERSION_gmp_thud ?= "6.1.%"
PREFERRED_VERSION_nettle ?= "3.2"
PREFERRED_VERSION_nettle_dunfell ?= "2.7.1"
PREFERRED_VERSION_nettle:kirkstone ?= "2.7.1"
PREFERRED_VERSION_nettle_thud ?= "3.4%"
PREFERRED_VERSION_gnutls_krogoth ?= "3.3.%"
PREFERRED_VERSION_gnutls_morty ?= "3.5.%"
PREFERRED_VERSION_gnutls_pyro ?= "3.3.%"
PREFERRED_VERSION_gnutls_rocko ?= "3.3.%"
PREFERRED_VERSION_gnutls_dunfell ?= "3.3.%"
PREFERRED_VERSION_gnutls:kirkstone ?= "3.3.%"
PREFERRED_VERSION_keyutils_morty ?= "1.5.9"
PREFERRED_VERSION_keyutils ?= "1.6.1"
PREFERRED_VERSION_gnutls_thud ?= "3.6.%"
PREFERRED_VERSION_procps_dunfell ?= "3.3.12"

# by default wpewebkit will be taken from rdk layers
WPEWEBKIT ?= "wpe-webkit"

require conf/distro/include/rdk_security_flags.inc
# Restructure Root CA Trust Store RDKALL-2429
# Enabling the feature for ALL RDK Builds
DISTRO_FEATURES:append = " cpc-ca-store"
require conf/distro/include/rdk_lto.inc

PREFERRED_VERSION_lcms_morty ?= "2.7"
PREFERRED_VERSION_cmake_morty ?= "3.8.2"
PREFERRED_VERSION_cmake-native_morty ?= "3.8.2"
PREFERRED_VERSION_cmake:kirkstone ?= "3.22.3"
PREFERRED_VERSION_cmake-native:kirkstone ?= "3.22.3"
PREFERRED_VERSION_libarchive_morty ?= "3.2.2"


PREFERRED_VERSION_grpc_dunfell ?= "1.24%"
PREFERRED_VERSION_grpc:kirkstone ?= "1.45%"

PREFERRED_VERSION_cjson:kirkstone = "1.7.15"
PREFERRED_VERSION_yajl:kirkstone = "2.1.0"

EXTRA_VERSIONS_PATH ?= "${TMPDIR}/versions"

# eSDK distro Changes
include ${@bb.utils.contains('DISTRO_FEATURES', 'enable_esdk', 'conf/distro/include/rdk-esdk-conf.inc', 'xxx.inc', d)}

PREFERRED_PROVIDER_libwpe ?= "libwpe"

#Disable kernel image packages installation to rootfs, as it is not required for RDK disk image
PACKAGE_EXCLUDE += "kernel-image*"

PREFERRED_VERSION_meson-native = "0.61.3"
PREFERRED_VERSION_nghttp2 = "${@bb.utils.contains('DISTRO_FEATURES', 'enable_libsoup3', "1.48.0", "", d)}"
PREFERRED_VERSION_glib-2.0 = "${@bb.utils.contains('DISTRO_FEATURES', 'enable_libsoup3', "2.72.3", "", d)}"
PREFERRED_VERSION_glib-2.0-native = "${@bb.utils.contains('DISTRO_FEATURES', 'enable_libsoup3', "2.72.3", "", d)}"
PREFERRED_VERSION_libpsl = "${@bb.utils.contains('DISTRO_FEATURES', 'enable_libsoup3', "0.21.1", "", d)}"
PREFERRED_VERSION_nativesdk-glib-2.0 = "${@bb.utils.contains('DISTRO_FEATURES', 'enable_libsoup3', "2.72.3", "", d)}"

PACKAGE_DEBUG_SPLIT_STYLE:kirkstone = "debug-without-src"

#PREFERRED_PROVIDER_virtual/ca-certificates-trust-store:client ?= "ca-certificates-trust-store"
PREFERRED_PROVIDER_virtual/firebolt ?= "ripple"

include conf/distro/rdk-cpc.conf
```
